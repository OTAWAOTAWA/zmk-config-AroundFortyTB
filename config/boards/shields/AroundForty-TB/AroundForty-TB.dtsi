/* config/boards/shields/around_forty_tb/around_forty_tb.dtsi
 *
 * 行列: 4行×5列（片手）/ 全体40キー（左右合算）
 * ダイオード方向: col2row
 *
 * ※ P0.10 を GPIO として使う場合は .conf に
 *    CONFIG_NFCT_PINS_AS_GPIOS=y を入れてください。
 */
#include <dt-bindings/zmk/matrix_transform.h>

 / {
    /* --- このシールドが使う KSCAN を指名 --- */
    chosen {
        zmk,kscan = &kscan0;
    };

    /* --- キーマトリクス (col2row) --- */
    kscan0: kscan_0 {
        compatible = "zmk,kscan-gpio-matrix";
        label = "KSCAN";
        diode-direction = "col2row";

        /* Rows（入力 / PULL_DOWN あり）
         *  D1, D2, D3, D6
         */
        row-gpios =
            <&xiao_d 1 (GPIO_ACTIVE_HIGH | GPIO_PULL_DOWN)>,
            <&xiao_d 2 (GPIO_ACTIVE_HIGH | GPIO_PULL_DOWN)>,
            <&xiao_d 3 (GPIO_ACTIVE_HIGH | GPIO_PULL_DOWN)>,
            <&xiao_d 6 (GPIO_ACTIVE_HIGH | GPIO_PULL_DOWN)>;

        /* Cols（出力 / プルなし）
         *  D10, D9, D8, D7, 追加: P0.10
         */
        col-gpios =
            <&xiao_d 10 GPIO_ACTIVE_HIGH>,
            <&xiao_d  9 GPIO_ACTIVE_HIGH>,
            <&xiao_d  8 GPIO_ACTIVE_HIGH>,
            <&xiao_d  7 GPIO_ACTIVE_HIGH>,
            <&gpio0   10 GPIO_ACTIVE_HIGH>;
    };

    /* --- キーマップ用のデフォルト変換（40キー分の map が必須） --- */
    default_transform: keymap_transform_0 {
        compatible = "zmk,matrix-transform";
        rows = <4>;
        columns = <10>;

        /* 左右で横にずらす量は overlay 側で上書きします
           （左: 0 / 右: 5 など） */
        col-offset = <0>;

        /* 40キーを行優先（左上→右下）で並べる */
        map = <MATRIX_TRANSFORM_ROW_MAJOR(
            /* row0 */  0,  1,  2,  3,  4,   5,  6,  7,  8,  9,
            /* row1 */ 10, 11, 12, 13, 14,  15, 16, 17, 18, 19,
            /* row2 */ 20, 21, 22, 23, 24,  25, 26, 27, 28, 29,
            /* row3 */ 30, 31, 32, 33, 34,  35, 36, 37, 38, 39
        )>;
    };
};
