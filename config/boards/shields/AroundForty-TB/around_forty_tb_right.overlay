#include "around_forty_tb.dtsi"

&spi0 {
    compatible = "nordic,nrf-spim";
    status = "okay";
    sck-pin = <13>;  // D8, P0.13
    mosi-pin = <17>; // D10, P0.17
    miso-pin = <15>; // D9, P0.15
};

/ {
    chosen {
        // 右手側をポインティングデバイスに指定
        zmk,pointing_device = &pmw3610_b_right;
    };

    pmw3610_b_right: pmw3610_b_right {
        compatible = "zmk,pointing-device-pmw3610-b"; // ポインティングデバイスとして定義
        label = "RIGHT_TB";
        spi = <&spi0>;
        cs-gpios = <&gpio0 5 (GPIO_ACTIVE_LOW | GPIO_PULL_UP)>;   // D5, P0.05
        mot-gpios = <&gpio0 4 GPIO_ACTIVE_LOW>; // D4, P0.04
    };
};
