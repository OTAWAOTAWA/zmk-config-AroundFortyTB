#include "around_forty_tb.dtsi"

&spi0 {
    compatible = "nordic,nrf-spim";
    status = "okay";
    sck-pin = <13>;  // D8, P0.13
    mosi-pin = <17>; // D10, P0.17
    miso-pin = <15>; // D9, P0.15
};

/ {
    pmw3610_b_left: pmw3610_b_left {
        compatible = "zmk,encoder-pmw3610-b"; // エンコーダーとして定義
        label = "LEFT_TB";
        spi = <&spi0>;
        cs-gpios = <&gpio0 5 (GPIO_ACTIVE_LOW | GPIO_PULL_UP)>;   // D5, P0.05
        mot-gpios = <&gpio0 4 GPIO_ACTIVE_LOW>; // D4, P0.04
        x-invert;
        y-invert;
    };
};
