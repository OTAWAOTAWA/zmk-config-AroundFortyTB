/* 共通キーマトリクス定義（col2row）
 * Cols: D10, D9, D8, D7, P0.10
 * Rows: D1, D2, D3, D6  （入力は PULL_DOWN）
 *
 * ※ P0.10 を GPIO として使う場合は .conf に
 * CONFIG_NFCT_PINS_AS_GPIOS=y
 * を入れてください。
 */
#include <dt-bindings/zmk/matrix_transform.h>

/ {
    /* --- 40キー用の共通トランスフォーム --- */
    default_transform: keymap_transform_0 {
        compatible = "zmk,matrix-transform";
        rows = <4>;
        columns = <10>;
        col-offset = <0>;

        /*
         * 左上→右下の行優先で 40 キーを並べる
         * (マクロ内はコメントを削除)
         */
        map = <MATRIX_TRANSFORM_ROW_MAJOR(
             0,  1,  2,  3,  4,   5,  6,  7,  8,  9,
            10, 11, 12, 13, 14,  15, 16, 17, 18, 19,
            20, 21, 22, 23, 24,  25, 26, 27, 28, 29,
            30, 31, 32, 33, 34,  35, 36, 37, 38, 39
        )>;
    };

    /* --- このシールドで使う KSCAN を指名 --- */
    chosen {
        zmk,kscan = &kscan0;
    };

    /* --- キーマトリクス (col2row) --- */
    kscan0: kscan_0 {
        compatible = "zmk,kscan-gpio-matrix";
        label = "KSCAN";
        diode-direction = "col2row";

        /*
         * Rows（入力 / PULL_DOWN あり）
         * Row0: P0.03 (D1), Row1: P0.28 (D2), Row2: P0.29 (D3), Row3: P1.11 (D6)
         */
        row-gpios =
            <&xiao_d  1 (GPIO_ACTIVE_HIGH | GPIO_PULL_DOWN)>,
            <&xiao_d  2 (GPIO_ACTIVE_HIGH | GPIO_PULL_DOWN)>,
            <&xiao_d  3 (GPIO_ACTIVE_HIGH | GPIO_PULL_DOWN)>,
            <&xiao_d  6 (GPIO_ACTIVE_HIGH | GPIO_PULL_DOWN)>;

        /* Cols（出力 / プルなし）
         * D10=P1.15, D9=P1.14, D8=P1.13, D7=P1.12, 追加: P0.10
         */
        col-gpios =
            <&xiao_d 10 GPIO_ACTIVE_HIGH>,
            <&xiao_d  9 GPIO_ACTIVE_HIGH>,
            <&xiao_d  8 GPIO_ACTIVE_HIGH>,
            <&xiao_d  7 GPIO_ACTIVE_HIGH>,
            <&gpio0  10 GPIO_ACTIVE_HIGH>;
    };
};
