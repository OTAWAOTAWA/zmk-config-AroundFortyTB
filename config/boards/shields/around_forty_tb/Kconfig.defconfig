## config/boards/shields/around_forty_tb/Kconfig.defconfig
```kconfig
if SHIELD_AROUND_FORTY_BBN_RIGHT

config ZMK_KEYBOARD_NAME
    string
    default "AroundFortyBBN_R"

config ZMK_SPLIT
    default y

config ZMK_SPLIT_ROLE_CENTRAL
    default y

endif

if SHIELD_AROUND_FORTY_BBN_LEFT
config ZMK_KEYBOARD_NAME
    default "AroundFortyBBN_L"

config ZMK_SPLIT
    default y

endif

if SHIELD_AROUND_FORTY_BBN_LEFT_N
config ZMK_KEYBOARD_NAME
    default "AroundFortyBBN_LN"

config ZMK_SPLIT
    default y

endif
```

## config/boards/shields/around_forty_tb/Kconfig.shield
```kconfig
config SHIELD_AROUND_FORTY_BBN_RIGHT
    def_bool $(shields_list_contains,around_forty_tb_right)

config SHIELD_AROUND_FORTY_BBN_LEFT
    def_bool $(shields_list_contains,around_forty_tb_left)

config SHIELD_AROUND_FORTY_BBN_LEFTN
    def_bool $(shields_list_contains,AroundForty-RB_R)
```

## config/west.yml
```yaml
manifest:
  remotes:
    - name: zmkfirmware
      url-base: https://github.com/zmkfirmware
    - name: razilyis
      url-base: https://github.com/razilyis
    - name: caksoylar
      url-base: https://github.com/caksoylar
  projects:
    - name: zmk
      remote: zmkfirmware
      revision: main
      import: app/west.yml
    - name: zmk-pmw3610-driver-b
      remote: razilyis
      revision: main
    - name: zmk-rgbled-widget
      remote: caksoylar
      revision: main
    - name: prospector-zmk-module
      remote: prospector
      revision: v1.0.0
      path: modules/prospector-zmk-module
  self:
    path: config
```
